## Kconfig
```kconfig
menu "SDI12 Bus"
    config SDI12_ENABLE_DEBUG_LOG
        bool "Enable Local LOG Debug Level"
        default n
            
endmenu
```

## examples/scanner/main/Kconfig.projbuild
```kconfig
menu "SDI12 Scanner Configuration"

    config EXAMPLE_SDI12_BUS_GPIO
        int "SDI12 bus pin number"
        range 0 34 if IDF_TARGET_ESP32
        range 0 46 if IDF_TARGET_ESP32S2 || IDF_TARGET_ESP32S3
        range 0 19 if IDF_TARGET_ESP32C3
        default 2
        help
            GPIO number for SDI12 bus pin. 

    config EXAMPLE_TASK_STACK_SIZE
        int "UART echo example task stack size"
        range 1024 16384
        default 2560
        help
            Defines stack size for UART echo example. Insufficient stack size can cause crash.

endmenu
```

## examples/usb-terminal/main/Kconfig.projbuild
```kconfig
menu "SDI12 <-> USB Configuration"
    
    config EXAMPLE_SDI12_BUS_GPIO
        int "SDI12 bus pin number"
        range 0 34 if IDF_TARGET_ESP32
        range 0 46 if IDF_TARGET_ESP32S2 || IDF_TARGET_ESP32S3
        range 0 19 if IDF_TARGET_ESP32C3
        default 17
        help
            GPIO number for SDI12 bus pin. 

endmenu
```
